## conf/bblayers.conf
```bitbake
# POKY_BBLAYERS_CONF_VERSION is increased each time build/conf/bblayers.conf
# changes incompatibly
POKY_BBLAYERS_CONF_VERSION = "2"

BBPATH = "${TOPDIR}"
BBFILES ?= ""

BBLAYERS ?= " \
  /home/${USER}/yocto/poky/meta \
  /home/${USER}/yocto/poky/meta-poky \ 
  /home/${USER}/yocto/meta-bbsmi \  
  /home/${USER}/yocto/meta-openembedded/meta-oe \
  /home/${USER}/yocto/meta-openembedded/meta-networking \
  /home/${USER}/yocto/meta-openembedded/meta-python \
  /home/${USER}/yocto/meta-openembedded/meta-multimedia \    
  /home/${USER}/yocto/meta-ti \    
  /home/${USER}/yocto/meta-mender/meta-mender-core \  
  "
```
